/*
 * lgdp4524if.c
 *
 *  Created on: 1 ���. 2018 �.
 *      Author: Dumitru
 */


/**************Imports***********************************/

#include "lgdp4524if.h"
#include "lgdp4524_pinout.h"

/*Start project specific inclusions*/
#include "stm32f4xx_hal.h"
#include "main.h"
/*End project specific inclusions*/


/**************Private Macro Definitions*****************/

#define WAIT_CYCLES(X) {uint8_t i; for(i = 0; i < X; i++);}

/**************Private Type Definitions******************/



/**************Private Variable Definitions**************/




/**************Public Variable Definitions***************/

fontdatatype SmallFont[1144] ={
0x08,0x0C,0x20,0x5F,
0x00,0x00,0x00,0x00,0x00,0x00,0x00,0x00,0x00,0x00,0x00,0x00, // <Space>
0x00,0x00,0x20,0x20,0x20,0x20,0x20,0x20,0x00,0x20,0x00,0x00, // !
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0x40,0xA4,0x18,0x00,0x00,0x00,0x00,0x00,0x00,0x00,0x00,0x00, // ~
};

// BigFont.c (C)2010 by Henning Karlsen
// Font Size    : 16x16
// Memory usage : 3044 bytes
// # characters : 95

fontdatatype BigFont[3044] ={
0x10,0x10,0x20,0x5F,
0x00,0x00,0x00,0x00,0x00,0x00,0x00,0x00,0x00,0x00,0x00,0x00,0x00,0x00,0x00,0x00,0x00,0x00,0x00,0x00,0x00,0x00,0x00,0x00,0x00,0x00,0x00,0x00,0x00,0x00,0x00,0x00, //  <Space>
0x00,0x00,0x00,0x00,0x07,0x00,0x0F,0x80,0x0F,0x80,0x0F,0x80,0x0F,0x80,0x0F,0x80,0x07,0x00,0x07,0x00,0x00,0x00,0x00,0x00,0x07,0x00,0x07,0x00,0x07,0x00,0x00,0x00, // !
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0x00,0x00,0x00,0x00,0x1F,0x1C,0x3B,0x9C,0x39,0xDC,0x38,0xF8,0x00,0x00,0x00,0x00,0x00,0x00,0x00,0x00,0x00,0x00,0x00,0x00,0x00,0x00,0x00,0x00,0x00,0x00,0x00,0x00  // ~
};

// SevenSegNumFont.c
// Font Size    : 32x50
// Memory usage : 2004 bytes
// # characters : 10

fontdatatype SevenSegNumFont[2004] ={
0x20,0x32,0x30,0x0A,
0x00,0x00,0x00,0x00,0x00,0x00,0x00,0x00,0x00,0xFF,0xFE,0x00,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0x00,  // 0
0x00,0x00,0x00,0x00,0x00,0x00,0x00,0x00,0x00,0x00,0x00,0x00,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0x00,  // 1
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0x00,0x00,0x00,0x00,0x00,0x00,0x00,0x00,0x00,0xFF,0xFE,0x00,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0x00,  // 9
};


uint16_t imageBleati[] =
{
		0xffff, 0xffff, 0xffff, 0xffff, 0xffff, 0xffff, 0xffff, 0xffff, 0xffff, 0xffff, 0xffff, 0xffff,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 0xffff,
		0xffff, 0xffff, 0xffff, 0xffff, 0xffff, 0xffff, 0xffff, 0xffff, 0xffff, 0xffff, 0xffff, 0xffff,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 0xffff,
		0xffff, 0xffff, 0xffff, 0xffff, 0xffff, 0xffff, 0xffff, 0xffff, 0xffff, 0xffff, 0xffff, 0xffff,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 0xffff,
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		0xffff, 0xffff, 0xffff, 0xffff, 0xffff, 0xffff, 0xffff, 0xffff, 0x8c50, 0x8c71, 0xf7be, 0xf7bd,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 0xb575
};

/**************Private Function Definitions**************/

void LGDP4524_DelayCycles(uint32_t cycles)
{
	uint32_t i;
	for (i = 0; i < cycles; i++);
}

/*---------------Start uC dependent interfaces---------------*/

void SetLow(volatile void* selectedPort, uint32_t selectedPins)
{
	HAL_GPIO_WritePin((GPIO_TypeDef*)selectedPort, selectedPins, GPIO_PIN_RESET);
}


void SetHigh(volatile void* selectedPort, uint32_t selectedPins)
{
	HAL_GPIO_WritePin((GPIO_TypeDef*)selectedPort, selectedPins, GPIO_PIN_SET);
}

/*---------------End uC dependent interfaces---------------*/

#ifndef FSMC_IS_USED
void SetPinAsInput(volatile void* selectedPort, uint16_t selectedPin)
{
    *(selectedPort+1) &= ~selectedPin;
}

void SetPinAsOutput(volatile void* selectedPort, uint16_t selectedPin)
{
    *(selectedPort+1) |= selectedPin;
}

uint8_t GetPinValue(volatile void* selectedPort, uint16_t selectedPin){
    //return GPIO_getInputPinValue(selectedPort, selectedPins);
    uint8_t value;
    value = (*(selectedPort-1)) & selectedPin;
    if (value){
        return 1;
    }
    else
    {
        return 0;
    }
}

void ConfigPinsAsOutput(volatile void* selectedPort, uint16_t selectedPins){
    GPIO_setAsOutputPin(selectedPort, selectedPins);
}

void ConfigPinsAsInput(volatile void* selectedPort, uint16_t selectedPins){
    GPIO_setAsInputPinWithPullUpResistor(selectedPort, selectedPins);
}

void SetPin(volatile void* selectedPort, uint16_t selectedPin, uint8_t value)
{
    if (value)
    {
        SetHigh(selectedPort, selectedPin);
    }
    else
    {
        SetLow(selectedPort, selectedPin);
    }
}

#endif
/**************Public Function Definitions***************/


void LGDP4524_Delay_ms(uint16_t miliseconds)
{
    HAL_Delay(miliseconds);
}

inline void LGDP4524_Delay_micro(volatile uint16_t  microseconds)
{
    microseconds *= (SystemCoreClock/1000000)/5;
    while(microseconds--);
}

#ifndef FSMC_IS_USED
void SetDataDirectionRegister(uint8_t direction){
    if (direction == LCD_OUTPUT_BUS){
        //ConfigPinsAsOutput(DB0_PORT, DB0_PIN);
        //ConfigPinsAsOutput(DB1_PORT, DB1_PIN);
        //ConfigPinsAsOutput(DB2_PORT, DB2_PIN);
        //ConfigPinsAsOutput(DB3_PORT, DB3_PIN);
        //ConfigPinsAsOutput(DB4_PORT, DB4_PIN);
        //ConfigPinsAsOutput(DB5_PORT, DB5_PIN);
        //ConfigPinsAsOutput(DB6_PORT, DB6_PIN);
        //ConfigPinsAsOutput(DB7_PORT, DB7_PIN);
    }
    else{
        if (direction == LCD_INPUT_BUS){
            //ConfigPinsAsInput(DB0_PORT, DB0_PIN);
            //ConfigPinsAsInput(DB1_PORT, DB1_PIN);
            //ConfigPinsAsInput(DB2_PORT, DB2_PIN);
            //ConfigPinsAsInput(DB3_PORT, DB3_PIN);
            //ConfigPinsAsInput(DB4_PORT, DB4_PIN);
            //ConfigPinsAsInput(DB5_PORT, DB5_PIN);
            //ConfigPinsAsInput(DB6_PORT, DB6_PIN);
            //ConfigPinsAsInput(DB7_PORT, DB7_PIN);
        }
    }
}
#endif

void LGDP4524_PinoutInit(void){

#ifdef FSMC_IS_USED

#else
    /* Configure all pins as output */

    //ConfigPinsAsOutput(RST_PORT, RST_PIN);
    //ConfigPinsAsOutput(WR_PORT,  WR_PIN);
    //ConfigPinsAsOutput(RS_PORT,  RS_PIN);
    //ConfigPinsAsOutput(RD_PORT,  RD_PIN);
    //ConfigPinsAsOutput(CS_PORT,  CS_PIN);

    SetDataDirectionRegister(LCD_OUTPUT_BUS);

    SetHigh(RST_PORT, RST_PIN);
    SetHigh(WR_PORT,  WR_PIN);
    SetHigh(RS_PORT,  RS_PIN);
    SetHigh(RD_PORT,  RD_PIN);
    SetHigh(CS_PORT,  CS_PIN);
    SetLow(DB0_PORT, DB0_PIN);
    SetLow(DB1_PORT, DB1_PIN);
    SetLow(DB2_PORT, DB2_PIN);
    SetLow(DB3_PORT, DB3_PIN);
    SetLow(DB4_PORT, DB4_PIN);
    SetLow(DB5_PORT, DB5_PIN);
    SetLow(DB6_PORT, DB6_PIN);
    SetLow(DB7_PORT, DB7_PIN);
#endif
}

void PullDownRST(void){
    SetLow(RST_PORT, RST_PIN);
}

void PullUpRST(void){
    SetHigh(RST_PORT, RST_PIN);
}

#ifndef FSMC_IS_USED
void PullDownWR(void){
    SetLow(WR_PORT, WR_PIN);
}

void PullUpWR(void){
    SetHigh(WR_PORT, WR_PIN);
}


void PullDownCS(void){
    SetLow(CS_PORT, CS_PIN);
}

void PullUpCS(void){
    SetHigh(CS_PORT, CS_PIN);
}

void PullDownRS(void){
    SetLow(RS_PORT, RS_PIN);
}

void PullUpRS(void){
    SetHigh(RS_PORT, RS_PIN);
}

void PullDownRD(void){
    SetLow(RD_PORT, RD_PIN);
}

void PullUpRD(void){
    SetHigh(RD_PORT, RD_PIN);
}


void TrigWrite(void){
    PullDownWR();
    PullUpWR();
}

uint8_t GetDataFromParallelPort(void)
{

	 uint8_t portData;

    portData  = GetPinValue(DB0_PORT, DB0_PIN);
    portData |= (GetPinValue(DB1_PORT, DB1_PIN)<<1);
    portData |= (GetPinValue(DB2_PORT, DB2_PIN)<<2);
    portData |= (GetPinValue(DB3_PORT, DB3_PIN)<<3);
    portData |= (GetPinValue(DB4_PORT, DB4_PIN)<<4);
    portData |= (GetPinValue(DB5_PORT, DB5_PIN)<<5);
    portData |= (GetPinValue(DB6_PORT, DB6_PIN)<<6);
    portData |= (GetPinValue(DB7_PORT, DB7_PIN)<<7);

    return portData;
}

void SetDataToParallelPort(uint16_t data)
{

    SetPin(DB0_PORT, DB0_PIN, data&0x01);
    SetPin(DB1_PORT, DB1_PIN, data&0x02);
    SetPin(DB2_PORT, DB2_PIN, data&0x04);
    SetPin(DB3_PORT, DB3_PIN, data&0x08);
    SetPin(DB4_PORT, DB4_PIN, data&0x10);
    SetPin(DB5_PORT, DB5_PIN, data&0x20);
    SetPin(DB6_PORT, DB6_PIN, data&0x40);
    SetPin(DB7_PORT, DB7_PIN, data&0x80);
}
#endif


#ifdef FSMC_IS_USED
void FSMC_Write_Cmd(uint16_t cmd)
{
	ADDR_CMD = 0;
	ADDR_CMD = (uint8_t)(cmd&0x00FF);
}

void FSMC_Write_Data(uint16_t data)
{
	ADDR_DATA = (uint8_t)(data>>8);
	ADDR_DATA = (uint8_t)(data&0x00FF);
}

uint16_t FSMC_Read_Data(void)
{
	uint16_t reg_val = 0;
	reg_val = ADDR_DATA<<8;
	reg_val |= ADDR_DATA;
	return reg_val;
}

#endif
